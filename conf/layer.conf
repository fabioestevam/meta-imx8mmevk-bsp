## conf/layer.conf
```bitbake
# We have a conf and classes directory, add to BBPATH
BBPATH .= ":${LAYERDIR}"

# We have a packages directory, add to BBFILES
BBFILES += "${LAYERDIR}/recipes-*/*/*.bb"
BBFILES += "${LAYERDIR}/recipes-*/*/*.bbappend"

BBFILE_COLLECTIONS += "imx8mmevkbsp"
BBFILE_PATTERN_imx8mmevkbsp = "^${LAYERDIR}/"
BBFILE_PRIORITY_imx8mmevkbsp = "5"

LAYERDEPENDS_imx8mmevkbsp = "core mainlinecommon-layer"
LAYERSERIES_COMPAT_imx8mmevkbsp = "dunfell kirkstone scarthgap"
```

## conf/machine/imx8mmevk.conf
```bitbake
#@TYPE: Machine
#@NAME: i.MX8MM EVK
#@SOC:  NXP IMX8MM
#@DESCRIPTION: Machine configuration for the i.MX8MM EVK

require conf/machine/include/imx8mmevk-common.inc

# U-Boot bootloader
UBOOT_MACHINE = "imx8mm_evk_defconfig"

# Linux kernel
KERNEL_DEVICETREE = " \
	freescale/imx8mm-evk.dtb \
	"
```

## scripts/lib/wic/canned-wks/emmcimage-imx8mmevk.wks
```
# short-description: Create i.MX8M EVK eMMC card image with a boot partition
# long-description: Creates a partitioned eMMC card image. Boot files
# are located in the first ext4 partition.

part --source rawcopy --sourceparams="file=flash.bin" --ondisk mmcblk --no-table --align 33 --size 10M

part / --source rootfs --ondisk mmcblk1 --fstype=ext4 --label rootfs1 --active --align 4096
part / --source rootfs --ondisk mmcblk1 --fstype=ext4 --label rootfs2 --active --align 4096
```
